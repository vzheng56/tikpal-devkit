## firmware/components/yaykit_cloud/Kconfig
```kconfig
menu "Yaykit cloud"

config YK_CLOUD_ORIGIN
    string "Device API origin"
    default "https://device.yaykit.io"
    help
        Origin of the device API (services/device). Yaykit has one environment since 2026-10-17. Until
        image signing ships (docs/architecture/device-platform.md 6.2), cloud firmware goes only to
        internal test builds, not public releases.

config YK_REGIONS
    bool "Choose the deployment by the device's region (two deployments)"
    default n
    help
        Two deployments, elsewhere (global) and mainland China (cn), from one firmware (docs/delivery/
        2026-11-20-两套部署-总纲.md; the firmware's plan 4.1-4.5). The addresses are the contract's region table,
        include/yk_regions_gen.h (pnpm contracts:sync writes it), which only yk_region.c reads. On, the device's
        region is yk_acct `rg` as stored, read once at start: no `rg`, or a name not in the table, is row 0, global.
        yk_cloud_origin() and yk_session_url() (yaykit_session) are then that row's addresses; global's stay
        CONFIG_YK_CLOUD_ORIGIN and YK_SESSION_URL, so a development build's own origin still works.
        Off (the default, every firmware until the release that turns it on): always global, nothing read from NVS,
        the addresses exactly today's. This setting writes no `rg`: activation by the claim's prefix does, later.

config YK_CLOUD_HTTP_BUFFER_MIN
    int "Smallest HTTP buffer, in bytes"
    default 0
    help
        An HTTPS client's receive and send buffers are at least this. 0 leaves them as written (2 KB or less, in internal
        RAM). Set it above CONFIG_SPIRAM_MALLOC_ALWAYSINTERNAL to have them in PSRAM: about 3.5 KB less internal RAM for
        each request. With a limit above it (16384, some firmware here) they stay internal and only grow.

endmenu
```

## firmware/components/yaykit_tf/Kconfig
```kconfig
menu "Yaykit TF card"

config YK_TF_READ_ONLY
    bool "The card is read-only (test bench)"
    default n
    help
        The disk under FatFs has no way to write, and no directory is made: for shared-test, which looks at cards that
        may hold someone's old recordings. Never in a firmware that ships.

config YK_TF_SYSTEM
    bool "The system's side of the card (Yay, shared-test)"
    default n
    select FATFS_USE_LABEL
    help
        sys_include/yk_tf_sys.h and yk_tf_pkg.h: the system area, the store of app images and 形象 packs, the index in
        NVS. Only the main firmware and the test bench, which also put sys_include/ on their include path; never an
        app, and the kit has none of it (Yay 0.1.19 开发文档 6.1). Without it the card still cleans up after a power
        cut, measures an app's space and stops before deep sleep. It turns on FatFs's volume label: the system names
        a card that has no name TIKPAL (4.2).

endmenu
```

## firmware/components/yaykit_ui/Kconfig
```kconfig
menu "Yaykit UI"

config YK_UI_PIP_BUILTIN
    bool "Pip's pictures in the image"
    default y
    help
        Pip's poses (firmware/assets/yay: 16 pictures, 628,416 bytes) are built into the image, as every firmware has
        them. Off (Yay from 0.1.18, Yay 0.1.18 开发文档 4.2): only greet_132 (18,464 bytes) is, and every pose is drawn
        as it until the firmware hangs Pip's pack with yk_yay_pip(): Yay reads it from Pip's place in `models`. An
        extension leaves this on: it has no Pip's place of its own to read.

config YK_UI_BUDDY_DEFAULT
    bool "Every Yay is the user's buddy"
    default y
    help
        yk_yay_create() draws the buddy the user chose (development kit 1.10, YK_API_LEVEL 5; 开发包四个伙伴-需求确认.md
        §4): Pip, or Mote, Dial or Bloom from the pack the main firmware keeps in a buddy slot (about 630 KB of PSRAM,
        read once a run on the first Yay made), Pip when it is not there. yk_yay_buddy() names another. Off (Yay): every
        Yay is Pip until a pack is hung with yk_yay_figure(), as before; Yay hangs its packs itself.

endmenu
```
