## firmware/components/yaykit_session/Kconfig
```kconfig
menu "Yaykit session"

    config YK_SESSION_TLS_TICKETS
        bool "Resume the session's TLS with a ticket kept across restarts"
        default y
        depends on ESP_TLS_CLIENT_SESSION_TICKETS
        help
            The session keeps the server's session ticket from each connection in RTC memory (the last 2 KB of RTC
            slow memory, the same place in every firmware; never in flash) and offers it once on the next connection,
            in this firmware or the next one after an app switch: a resumed handshake instead of a whole one
            (docs/delivery/2026-10-27-connecting-and-fast-reconnect.md 4). TLS 1.2 (an abbreviated handshake: no
            certificate chain to check, no key exchange, one round trip less) and, when the firmware turns it on,
            TLS 1.3. A ticket the server does not take costs nothing: the handshake is a whole one. Needs
            CONFIG_ESP_TLS_CLIENT_SESSION_TICKETS; off, the session connects as before.

endmenu
```
